//spi interface for glcdd nokia5110
// the lcd is connect to spi1 (sck and mosi to Clk and Din respectively)
// CS is connected to PA1
// RS is connected to PA2
// DC is connected to PA3 


#include "nokia5110.h"
#include <math.h>
#define PI 3.14
static const char xkcdSandwich[504] = {
0xFF, 0x8D, 0x9F, 0x13, 0x13, 0xF3, 0x01, 0x01, 0xF9, 0xF9, 0x01, 0x81, 0xF9, 0xF9, 0x01, 0xF1,
0xF9, 0x09, 0x09, 0xFF, 0xFF, 0xF1, 0xF9, 0x09, 0x09, 0xF9, 0xF1, 0x01, 0x01, 0x01, 0x01, 0x01,
0xF9, 0xF9, 0x09, 0xF9, 0x09, 0xF9, 0xF1, 0x01, 0xC1, 0xE9, 0x29, 0x29, 0xF9, 0xF1, 0x01, 0xFF,
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0x80, 0x80, 0x80, 0x80, 0x80, 0x80, 0x80, 0xFF,
};

int main (void){

lcdBegin();
updateDisplay(); // with displayMap untouched, SFE logo
setContrast(60); // Good values range from 40-60
delay(2000);
while(1){


  setStr("STM32 NOKIA5110 bare metal", 0, LCD_HEIGHT-8, BLACK);
  updateDisplay();
  delay(1000);
  for (int i=0; i<5; i++)
  {
    invertDisplay();
    delay(200);
    invertDisplay();
    delay(200);
  }
  delay(2000);


  clearDisplay(WHITE);
  int x0 = LCD_WIDTH/2;
  int y0 = LCD_HEIGHT/2;
 for (float i=0; i<2*PI; i+=PI/8)
 {
  const int lineLength = 24;
  int x1 = x0 + lineLength * sin(i);
  int y1 = y0 + lineLength * cos(i);
  setLine(x0, y0, x1, y1, BLACK);
  updateDisplay();
	delay(100);
 }
  clearDisplay(WHITE); // Start fresh
  for (int x=0; x<LCD_WIDTH; x+=8)
  { // Swipe right black
    setRect(0, 0, x, LCD_HEIGHT, 1, BLACK);
    updateDisplay();
    delay(10);
  }
  for (int x=0; x<LCD_WIDTH; x+=8)
  {
    setRect(0, 0, x, LCD_HEIGHT, 1, WHITE);
    updateDisplay();
    delay(10);
  }
  for (int x=0; x<12; x++)
  {
    setRect(0, 0, x, LCD_HEIGHT, 1, 1);
    setRect(11, 0, x+12, LCD_HEIGHT, 1, BLACK);
    setRect(23, 0, x+24, LCD_HEIGHT, 1, BLACK);
    setRect(35, 0, x+36, LCD_HEIGHT, 1, BLACK);
    setRect(47, 0, x+48, LCD_HEIGHT, 1, BLACK);
    setRect(59, 0, x+60, LCD_HEIGHT, 1, BLACK);
    setRect(71, 0, x+72, LCD_HEIGHT, 1, BLACK);
    updateDisplay();
    delay(10);
  }
  setRect(25, 10, 45, 30, 0, WHITE);
  setRect(35, 20, 55, 40, 0, WHITE);
  setLine(25, 10, 35, 20, WHITE);
  setLine(45, 30, 55, 40, WHITE);
  setLine(25, 30, 35, 40, WHITE);
  setLine(45, 10, 55, 20, WHITE);
  updateDisplay();
  delay(2000);
  clearDisplay(WHITE);
  delay(2000);
  setStr("Modern Art", 0, 10, WHITE);
  updateDisplay();
  delay(2000);
  SetBitMap(xkcdSandwich);
  updateDisplay();
	delay(5000);
}
}
